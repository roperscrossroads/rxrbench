## collections/ansible_collections/rxrbench/linux/sim/vm/meta-rxrbench-sim/conf/layer.conf
```bitbake
BBPATH .= ":${LAYERDIR}"
BBFILES += "${LAYERDIR}/recipes-*/*/*.bb ${LAYERDIR}/recipes-*/*/*.bbappend"
BBFILE_COLLECTIONS += "rxrbench-sim"
BBFILE_PATTERN_rxrbench-sim = "^${LAYERDIR}/"
BBFILE_PRIORITY_rxrbench-sim = "20"
LAYERDEPENDS_rxrbench-sim = "core rauc slotguard"
LAYERSERIES_COMPAT_rxrbench-sim = "wrynose"
```
