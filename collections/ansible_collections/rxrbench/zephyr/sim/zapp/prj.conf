## CMakeLists.txt
```
# zapp: the example application of the rxrbench.zephyr plugin (docs/SIMULATED.md). A Zephyr
# application that keeps its configuration in the settings subsystem and takes the settings
# shell, as any Zephyr application can; built for native_sim by `just sim-zapp-build`, and for
# real boards by `just zapp-build` (hw/README.md).
cmake_minimum_required(VERSION 3.20.0)
find_package(Zephyr REQUIRED HINTS $ENV{ZEPHYR_BASE})
project(zapp)
target_sources(app PRIVATE src/main.c src/shell.c src/features.c)

# each feature its own file; the list goes beside the image for the catalog
set(features "")
foreach(f DIGEST STATE LOCATE SELFTEST BOOTSEL WIFI HAWKBIT)
  if(CONFIG_ZAPP_${f})
    string(TOLOWER ${f} name)
    target_sources(app PRIVATE src/${name}.c)
    list(APPEND features ${name})
  endif()
endforeach()
if(CONFIG_REBOOT)
  list(APPEND features reboot)
endif()
list(SORT features)
string(REPLACE ";" " " features_text "${features}")
file(WRITE ${CMAKE_BINARY_DIR}/zapp-features.txt "${features_text}\n")
target_compile_definitions(app PRIVATE ZAPP_FEATURES="${features_text}")
```

## Kconfig
```
mainmenu "zapp"

config ZAPP_VERSION
	string "The application's version"
	default "1.0"
	help
	  Written to the setting app/version at every boot, so a bench can read which build a
	  board runs; the image's identity is its hash, this is for the device tests.

# What a build provides: each feature is a `zapp <command>` and a file of its own. The build
# writes the list to zapp-features.txt, and `zapp features` prints it, so a catalog entry's
# `features` come from the build, never typed.

config ZAPP_DIGEST
	bool "zapp digest: the SHA-256 of a stored setting"
	default y
	help
	  A secret is compared by its digest, never crossing the console; a value longer than the
	  settings shell reads back (256 bytes) is checked whole.

config ZAPP_STATE
	bool "zapp state: rxrbench's state line"
	select CRC
	select HWINFO
	help
	  One line, ~S{json}*crc16 (docs/PLUGINS.md "The state line"): the family, the app, its
	  version, the board target and the chip's id.

config ZAPP_LOCATE
	bool "zapp locate: the board's LED, to find it on a bench"
	depends on $(dt_alias_enabled,led0) || $(dt_alias_enabled,led-strip)
	select LED_STRIP if $(dt_alias_enabled,led-strip)
	select GPIO if $(dt_alias_enabled,led0)

config ZAPP_SELFTEST
	bool "zapp test: checks of the board's hardware"
	help
	  `zapp test <name>` prints `test <name> pass <detail>` or `test <name> fail <why>`:
	  settings on flash (write, read back, delete), the entropy source, the die temperature
	  where the chip has a sensor, WiFi when the build has it. A layout binds them as device
	  tests (`bench_tests`).

config ZAPP_BOOTSEL
	bool "rp2 bootsel: into the RP2040's or RP2350's ROM bootloader"
	depends on SOC_FAMILY_RPI_PICO
	help
	  So a bench can write the next image with no button: the picoboot flasher asks for it
	  (`shell:rp2 bootsel`).

config ZAPP_WIFI
	bool "WiFi from settings: wifi/ssid, wifi/psk"
	depends on WIFI && NET_DHCPV4
	help
	  At boot, and on `zapp wifi connect`, joins the network the settings name (a PSK network
	  when wifi/psk is set, an open one otherwise) and takes an address by DHCP. `zapp wifi
	  status` says where it is. The PSK is a secret the layout declares.

config ZAPP_HAWKBIT
	bool "Updates from an Eclipse hawkBit server the device polls"
	depends on HAWKBIT && HAWKBIT_SET_SETTINGS_RUNTIME && HAWKBIT_CUSTOM_DEVICE_ID
	depends on !HAWKBIT_AUTOHANDLER && !HAWKBIT_CONFIRM_IMG_ON_INIT
	select NET_MGMT_EVENT
	help
	  Zephyr's hawkBit client (subsys/mgmt/hawkbit) on a thread of its own: it asks the
	  server, downloads an update into the second slot and reboots into it. The settings
	  zhb/server, zhb/port, zhb/id and zhb/token say which server, under which name and
	  with which token; `zapp hawkbit status` says where it is. An image on its test boot
	  confirms itself after ZAPP_HAWKBIT_CONFIRM_SEC of uptime, and the client asks nothing
	  of the server before that, so the server hears of an update only from an image that
	  came up and stayed up. A fault must reset the device (RESET_ON_FATAL_ERROR, or a
	  watchdog), or an image that hangs on its test boot is never swapped back.

config ZAPP_HAWKBIT_CONFIRM_SEC
	int "Confirm an image on its test boot after this many seconds of uptime"
	depends on ZAPP_HAWKBIT
	default 60

config ZAPP_HAWKBIT_MIN_POLL_SEC
	int "Never ask the server more often than this"
	depends on ZAPP_HAWKBIT
	default 30

config ZAPP_HAWKBIT_FAULT_SEC
	int "For an image made to fail: fault this many seconds into a test boot"
	depends on ZAPP_HAWKBIT
	default 0
	help
	  0: never. Otherwise an image on its test boot (not yet confirmed) panics once it has
	  been up this long, before it would confirm itself: the device resets and MCUboot
	  returns to the image it ran. For a bench to show an update that fails on the device.

config ZAPP_CONSOLE_FLOW_CONTROL
	bool "Flow control on the shell's serial port, turned on once zapp is up"
	depends on SERIAL
	select UART_USE_RUNTIME_CONFIGURE
	help
	  For MCUmgr over the shell on a USB CDC ACM port. The shell transport writes a response a
	  byte at a time with uart_poll_out, faster than a USB packet (64 bytes) leaves, and
	  without flow control the port drops what does not fit: a response longer than one
	  packet (image state, an upload's reply) never arrives. With it, uart_poll_out waits
	  for room. Turned on from main, not in the devicetree: anything printed before the USB
	  stack is enabled (the boot banner, the WiFi driver's firmware line) would wait for a
	  host that cannot connect yet, and the board would never enumerate. Once on, a write to
	  the console waits while no host reads the port; on a bench the board's broker holds it.

source "Kconfig.zephyr"
```

## prj.conf
```kconfig
# The shell (the bench's console), and the settings subsystem on the flash simulator (the
# board's flash file), with its shell: `settings read|write|list|delete`. A value as long as a
# certificate fits one command line.
CONFIG_SHELL=y
CONFIG_KERNEL_SHELL=y
CONFIG_SHELL_CMD_BUFF_SIZE=2048
CONFIG_SHELL_PRINTF_BUFF_SIZE=256
CONFIG_SHELL_PROMPT_UART="zapp:~$ "
CONFIG_FLASH=y
CONFIG_FLASH_MAP=y
CONFIG_FLASH_SIMULATOR=y
CONFIG_NVS=y
CONFIG_SETTINGS=y
CONFIG_SETTINGS_NVS=y
CONFIG_SETTINGS_SHELL=y
# a key made at first boot wants randomness: the fake entropy driver, seeded per run
CONFIG_ENTROPY_GENERATOR=y
```

## src/main.c
```c
/*
 * zapp: a Zephyr application that keeps what a device keeps. At boot it loads its settings
 * from flash; a device that has no key yet makes one (32 random bytes, as hex) and saves it
 * under app/key, so the key is the device's own, made once and kept across reboots and
 * updates until the storage is erased. Its version goes to app/version at every boot, so a
 * bench can read which build runs. Everything else (a pre-shared key, a certificate, any
 * setting a bench declares) is written and read through the settings shell.
 */
#include <errno.h>
#include <stdio.h>
#include <string.h>

#include <zephyr/device.h>
#include <zephyr/drivers/uart.h>
#include <zephyr/kernel.h>
#include <zephyr/random/random.h>
#include <zephyr/settings/settings.h>

#include "zapp.h"

#define KEY_BYTES 32

static char device_key[KEY_BYTES * 2 + 1];

static int app_set(const char *name, size_t len, settings_read_cb read_cb, void *cb_arg)
{
	const char *next;

	if (settings_name_steq(name, "key", &next) && !next) {
		if (len >= sizeof(device_key)) {
			return -EINVAL;
		}
		ssize_t n = read_cb(cb_arg, device_key, len);

		if (n < 0) {
			return (int)n;
		}
		device_key[n] = '\0';
		return 0;
	}
	/* any other setting under app/ is somebody else's to read (the shell reads it) */
	return 0;
}

SETTINGS_STATIC_HANDLER_DEFINE(zapp, "app", NULL, app_set, NULL, NULL);

/* Kconfig ZAPP_CONSOLE_FLOW_CONTROL: on now that the USB stack is up, never before it. */
static void console_flow_control(void)
{
#if defined(CONFIG_ZAPP_CONSOLE_FLOW_CONTROL) && DT_HAS_CHOSEN(zephyr_shell_uart)
	const struct device *dev = DEVICE_DT_GET(DT_CHOSEN(zephyr_shell_uart));
	struct uart_config cfg;

	if (uart_config_get(dev, &cfg) == 0) {
		cfg.flow_ctrl = UART_CFG_FLOW_CTRL_RTS_CTS;
		if (uart_configure(dev, &cfg) != 0) {
			printk("zapp: no flow control on the console\n");
		}
	}
#endif
}

int main(void)
{
	console_flow_control();

	int rc = settings_subsys_init();

	if (rc) {
		printk("zapp: settings init failed (%d)\n", rc);
		return rc;
	}
	settings_load();
	if (device_key[0] == '\0') {
		uint8_t raw[KEY_BYTES];

		sys_rand_get(raw, sizeof(raw));
		for (int i = 0; i < KEY_BYTES; i++) {
			snprintf(&device_key[2 * i], 3, "%02x", raw[i]);
		}
		settings_save_one("app/key", device_key, strlen(device_key));
		printk("zapp: a key was made\n");
	}
	settings_save_one("app/version", CONFIG_ZAPP_VERSION, strlen(CONFIG_ZAPP_VERSION));
	if (IS_ENABLED(CONFIG_ZAPP_WIFI)) {
		zapp_wifi_start();   /* the network the settings name, if any */
	}
	printk("zapp %s: up\n", CONFIG_ZAPP_VERSION);
	return 0;
}
```

## src/bootsel.c
```c
/*
 * `rp2 bootsel` (and `zapp bootsel`): into the RP2040's or RP2350's ROM bootloader, its drive and
 * picotool's interface, so a bench writes the next image with no one pressing a button. The
 * picoboot flasher asks for it by the first name (a layout's bench_picoboot_enter).
 */
#include <zephyr/kernel.h>
#include <zephyr/shell/shell.h>
#include <pico/bootrom.h>

static int cmd_bootsel(const struct shell *sh, size_t argc, char **argv)
{
	shell_print(sh, "rebooting into the ROM bootloader");
	k_msleep(100);   /* the line reaches the host before USB goes */
	reset_usb_boot(0, 0);
	return 0;
}

SHELL_STATIC_SUBCMD_SET_CREATE(rp2_cmds,
	SHELL_CMD(bootsel, NULL, "reboot into the ROM bootloader (BOOTSEL)", cmd_bootsel),
	SHELL_SUBCMD_SET_END);
SHELL_CMD_REGISTER(rp2, &rp2_cmds, "RP2040 / RP2350", NULL);
SHELL_SUBCMD_ADD((zapp), bootsel, NULL, "reboot into the ROM bootloader (BOOTSEL)", cmd_bootsel, 1, 0);
```

## src/digest.c
```c
/*
 * `zapp digest <name>`: the SHA-256 and length of a stored setting, so a bench can check a value
 * the settings shell cannot read back whole (it shows 256 bytes at most), and a secret without
 * the secret crossing the console. Prints one line:
 *
 *     digest <name> <length> <sha256 hex>     or     digest <name> none
 *
 * SHA-256 is written out here (FIPS 180-4) so the app needs no crypto library: the same code
 * builds on every Zephyr the bench runs.
 */
#include <stdint.h>
#include <string.h>

#include <zephyr/kernel.h>
#include <zephyr/settings/settings.h>
#include <zephyr/shell/shell.h>

#define DIGEST_MAX_VALUE 2048   /* a value as long as one shell command line can write */

struct sha256 {
	uint32_t h[8];
	uint64_t bits;
	uint8_t block[64];
	size_t used;
};

static const uint32_t K[64] = {
	0x428a2f98, 0x71374491, 0xb5c0fbcf, 0xe9b5dba5, 0x3956c25b, 0x59f111f1, 0x923f82a4,
	0xab1c5ed5, 0xd807aa98, 0x12835b01, 0x243185be, 0x550c7dc3, 0x72be5d74, 0x80deb1fe,
	0x9bdc06a7, 0xc19bf174, 0xe49b69c1, 0xefbe4786, 0x0fc19dc6, 0x240ca1cc, 0x2de92c6f,
	0x4a7484aa, 0x5cb0a9dc, 0x76f988da, 0x983e5152, 0xa831c66d, 0xb00327c8, 0xbf597fc7,
	0xc6e00bf3, 0xd5a79147, 0x06ca6351, 0x14292967, 0x27b70a85, 0x2e1b2138, 0x4d2c6dfc,
	0x53380d13, 0x650a7354, 0x766a0abb, 0x81c2c92e, 0x92722c85, 0xa2bfe8a1, 0xa81a664b,
	0xc24b8b70, 0xc76c51a3, 0xd192e819, 0xd6990624, 0xf40e3585, 0x106aa070, 0x19a4c116,
	0x1e376c08, 0x2748774c, 0x34b0bcb5, 0x391c0cb3, 0x4ed8aa4a, 0x5b9cca4f, 0x682e6ff3,
	0x748f82ee, 0x78a5636f, 0x84c87814, 0x8cc70208, 0x90befffa, 0xa4506ceb, 0xbef9a3f7,
	0xc67178f2,
};

#define ROR(x, n) (((x) >> (n)) | ((x) << (32 - (n))))

static void sha256_block(struct sha256 *s, const uint8_t *p)
{
	uint32_t w[64], a, b, c, d, e, f, g, h;

	for (int i = 0; i < 16; i++) {
		w[i] = (uint32_t)p[4 * i] << 24 | (uint32_t)p[4 * i + 1] << 16 |
		       (uint32_t)p[4 * i + 2] << 8 | p[4 * i + 3];
	}
	for (int i = 16; i < 64; i++) {
		uint32_t s0 = ROR(w[i - 15], 7) ^ ROR(w[i - 15], 18) ^ (w[i - 15] >> 3);
		uint32_t s1 = ROR(w[i - 2], 17) ^ ROR(w[i - 2], 19) ^ (w[i - 2] >> 10);

		w[i] = w[i - 16] + s0 + w[i - 7] + s1;
	}
	a = s->h[0]; b = s->h[1]; c = s->h[2]; d = s->h[3];
	e = s->h[4]; f = s->h[5]; g = s->h[6]; h = s->h[7];
	for (int i = 0; i < 64; i++) {
		uint32_t t1 = h + (ROR(e, 6) ^ ROR(e, 11) ^ ROR(e, 25)) + ((e & f) ^ (~e & g)) + K[i] + w[i];
		uint32_t t2 = (ROR(a, 2) ^ ROR(a, 13) ^ ROR(a, 22)) + ((a & b) ^ (a & c) ^ (b & c));

		h = g; g = f; f = e; e = d + t1; d = c; c = b; b = a; a = t1 + t2;
	}
	s->h[0] += a; s->h[1] += b; s->h[2] += c; s->h[3] += d;
	s->h[4] += e; s->h[5] += f; s->h[6] += g; s->h[7] += h;
}

static void sha256(const uint8_t *data, size_t len, uint8_t out[32])
{
	static const uint32_t H0[8] = {0x6a09e667, 0xbb67ae85, 0x3c6ef372, 0xa54ff53a,
				       0x510e527f, 0x9b05688c, 0x1f83d9ab, 0x5be0cd19};
	struct sha256 s = {.bits = (uint64_t)len * 8};

	memcpy(s.h, H0, sizeof(H0));
	for (; len >= 64; len -= 64, data += 64) {
		sha256_block(&s, data);
	}
	memcpy(s.block, data, len);
	s.block[len++] = 0x80;
	if (len > 56) {
		memset(&s.block[len], 0, 64 - len);
		sha256_block(&s, s.block);
		len = 0;
	}
	memset(&s.block[len], 0, 56 - len);
	for (int i = 0; i < 8; i++) {
		s.block[56 + i] = (uint8_t)(s.bits >> (56 - 8 * i));
	}
	sha256_block(&s, s.block);
	for (int i = 0; i < 8; i++) {
		out[4 * i] = s.h[i] >> 24; out[4 * i + 1] = s.h[i] >> 16;
		out[4 * i + 2] = s.h[i] >> 8; out[4 * i + 3] = s.h[i];
	}
}

struct digest_read {
	bool found;
	ssize_t len;
	uint8_t value[DIGEST_MAX_VALUE];
};

static struct digest_read found_value;

static int digest_cb(const char *key, size_t len, settings_read_cb read_cb, void *cb_arg,
		     void *param)
{
	struct digest_read *r = param;

	/* the exact name only, as the settings shell's own read */
	if (settings_name_next(key, NULL) != 0) {
		return 0;
	}
	r->found = true;
	r->len = len > sizeof(r->value) ? -EFBIG : read_cb(cb_arg, r->value, len);
	return 0;
}

static int cmd_digest(const struct shell *sh, size_t argc, char **argv)
{
	uint8_t d[32];
	char hex[65];

	found_value.found = false;
	found_value.len = 0;
	int rc = settings_load_subtree_direct(argv[1], digest_cb, &found_value);

	if (rc) {
		shell_error(sh, "digest %s: error %d", argv[1], rc);
		return rc;
	}
	if (!found_value.found) {
		shell_print(sh, "digest %s none", argv[1]);
		return 0;
	}
	if (found_value.len < 0) {
		shell_error(sh, "digest %s: error %d", argv[1], (int)found_value.len);
		return (int)found_value.len;
	}
	sha256(found_value.value, (size_t)found_value.len, d);
	for (int i = 0; i < 32; i++) {
		snprintk(&hex[2 * i], 3, "%02x", d[i]);
	}
	shell_print(sh, "digest %s %d %s", argv[1], (int)found_value.len, hex);
	memset(found_value.value, 0, sizeof(found_value.value));   /* a secret does not linger */
	return 0;
}

SHELL_SUBCMD_ADD((zapp), digest, NULL, "<name>: the SHA-256 and length of a stored setting",
		 cmd_digest, 2, 0);
```

## src/features.c
```c
/*
 * `zapp version` and `zapp features`: which build this is and what it provides, as the build
 * listed it (CMakeLists.txt writes the same list to zapp-features.txt for the catalog).
 *
 *     version zapp 3.0
 *     features bootsel digest reboot selftest state
 */
#include <zephyr/shell/shell.h>

static int cmd_version(const struct shell *sh, size_t argc, char **argv)
{
	shell_print(sh, "version zapp %s", CONFIG_ZAPP_VERSION);
	return 0;
}

static int cmd_features(const struct shell *sh, size_t argc, char **argv)
{
	shell_print(sh, "features %s", ZAPP_FEATURES);
	return 0;
}

SHELL_SUBCMD_ADD((zapp), version, NULL, "this build's version", cmd_version, 1, 0);
SHELL_SUBCMD_ADD((zapp), features, NULL, "what this build provides", cmd_features, 1, 0);
```

## src/hawkbit.c
```c
/*
 * `zapp hawkbit`: updates from an Eclipse hawkBit server the device polls (Kconfig ZAPP_HAWKBIT).
 *
 * One thread runs Zephyr's hawkBit client: ask the server, download what it offers into the
 * second slot, reboot into it, and tell the server afterwards. Which server, under which name
 * and with which token are settings, written like any other and read before each poll:
 *
 *     zhb/server    the server's address          zhb/port     its port (8080 when not set)
 *     zhb/id        this target's controller id   zhb/token    its security token (a secret)
 *
 * It asks only with an address, a server and a name set, and with a CONFIRMED image: an image
 * on its test boot is confirmed here after ZAPP_HAWKBIT_CONFIRM_SEC of uptime, so the server
 * hears of an update only from an image that came up and stayed up.
 *
 *     zapp hawkbit probe      ask now
 *     zapp hawkbit status     hawkbit image <v> <confirmed|unconfirmed> server <addr:port|none>
 *                             id <name|none> token <set|none> net <up|down> action <n>
 *                             probes <n> last <result>
 */
#include <errno.h>
#include <stdlib.h>
#include <string.h>

#include <zephyr/dfu/mcuboot.h>
#include <zephyr/kernel.h>
#include <zephyr/mgmt/hawkbit/config.h>
#include <zephyr/mgmt/hawkbit/hawkbit.h>
#include <zephyr/net/net_event.h>
#include <zephyr/net/net_if.h>
#include <zephyr/net/net_mgmt.h>
#include <zephyr/settings/settings.h>
#include <zephyr/shell/shell.h>
#include <zephyr/storage/flash_map.h>

/* Zephyr before 4.5 names it FIXED_PARTITION_ID */
#ifndef PARTITION_ID
#define PARTITION_ID(label) FIXED_PARTITION_ID(label)
#endif

static K_SEM_DEFINE(kick, 0, 1);
static struct net_mgmt_event_callback ipv4_cb;
static enum hawkbit_response last = HAWKBIT_NO_RESPONSE;
static uint32_t probes;
static char target_id[65];
static char server[65];
static char port[6];
static char token[33];   /* a hawkBit security token is 32 characters */

static int zhb_set(const char *name, size_t len, settings_read_cb read_cb, void *cb_arg)
{
	const char *next;
	char *dst;
	size_t cap;

	if (settings_name_steq(name, "id", &next) && !next) {
		dst = target_id, cap = sizeof(target_id);
	} else if (settings_name_steq(name, "server", &next) && !next) {
		dst = server, cap = sizeof(server);
	} else if (settings_name_steq(name, "port", &next) && !next) {
		dst = port, cap = sizeof(port);
	} else if (settings_name_steq(name, "token", &next) && !next) {
		dst = token, cap = sizeof(token);
	} else {
		return -ENOENT;
	}
	if (len >= cap) {
		return -EINVAL;
	}
	ssize_t n = read_cb(cb_arg, dst, len);

	if (n < 0) {
		return (int)n;
	}
	dst[n] = '\0';
	return 0;
}

SETTINGS_STATIC_HANDLER_DEFINE(zapp_hawkbit, "zhb", NULL, zhb_set, NULL, NULL);

/* The settings as they stand now, given to the client where they differ from what it holds. */
static void configure(void)
{
	const char *have;
	uint16_t want_port;

	settings_load_subtree("zhb");   /* settings written since boot */
	want_port = port[0] ? (uint16_t)strtoul(port, NULL, 10) : 8080;
	have = hawkbit_get_server_addr();
	if (server[0] && (have == NULL || strcmp(have, server) != 0)) {
		(void)hawkbit_set_server_addr(server);
	}
	if (hawkbit_get_server_port() != want_port) {
		(void)hawkbit_set_server_port(want_port);
	}
	have = hawkbit_get_ddi_security_token();
	if (token[0] && (have == NULL || strcmp(have, token) != 0)) {
		(void)hawkbit_set_ddi_security_token(token);
	}
}

static const char *result(enum hawkbit_response r)
{
	switch (r) {
	case HAWKBIT_NO_RESPONSE: return "none";
	case HAWKBIT_UPDATE_INSTALLED: return "update-installed";
	case HAWKBIT_NO_UPDATE: return "no-update";
	case HAWKBIT_NETWORKING_ERROR: return "networking-error";
	case HAWKBIT_UNCONFIRMED_IMAGE: return "image-unconfirmed";
	case HAWKBIT_PERMISSION_ERROR: return "permission-error";
	case HAWKBIT_METADATA_ERROR: return "metadata-error";
	case HAWKBIT_DOWNLOAD_ERROR: return "download-error";
	case HAWKBIT_ALLOC_ERROR: return "allocation-error";
	case HAWKBIT_NOT_INITIALIZED: return "not-initialized";
	case HAWKBIT_PROBE_IN_PROGRESS: return "probe-in-progress";
	}
	return "?";
}

static bool identity(char *id, int id_max_len)
{
	if (target_id[0] == '\0') {
		return false;
	}
	strncpy(id, target_id, id_max_len - 1);
	id[id_max_len - 1] = '\0';
	return true;
}

/* An address of its own, asked of the interface each time: an event may have come and gone
 * before this thread was listening.
 */
static bool net_up(void)
{
	struct net_if *iface = net_if_get_default();

	return iface != NULL && net_if_ipv4_get_global_addr(iface, NET_ADDR_PREFERRED) != NULL;
}

/* A new address: ask now rather than at the next poll. */
static void ipv4_event(struct net_mgmt_event_callback *cb, uint64_t event, struct net_if *iface)
{
	k_sem_give(&kick);
}

static void poll_thread(void *a, void *b, void *c)
{
	uint32_t next = 5;
	const char *addr;

	net_mgmt_init_event_callback(&ipv4_cb, ipv4_event, NET_EVENT_IPV4_ADDR_ADD);
	net_mgmt_add_event_callback(&ipv4_cb);
	(void)hawkbit_set_device_identity_cb(identity);
	if (hawkbit_init() < 0) {
		printk("zapp: hawkbit init failed\n");
		return;
	}
	for (;;) {
		(void)k_sem_take(&kick, K_SECONDS(next));
		next = 5;
		if (!boot_is_img_confirmed()) {
			if (CONFIG_ZAPP_HAWKBIT_FAULT_SEC > 0 &&
			    k_uptime_get() / 1000 >= CONFIG_ZAPP_HAWKBIT_FAULT_SEC) {
				printk("zapp: FAULT TEST: this image faults on its test boot\n");
				k_sleep(K_MSEC(200));
				k_panic();
			}
			if (k_uptime_get() / 1000 < CONFIG_ZAPP_HAWKBIT_CONFIRM_SEC) {
				continue;
			}
			printk("zapp: still up after %d s: confirming the image (%d)\n",
			       CONFIG_ZAPP_HAWKBIT_CONFIRM_SEC, boot_write_img_confirmed());
		}
		configure();
		addr = hawkbit_get_server_addr();
		if (!net_up() || addr == NULL || addr[0] == '\0' || target_id[0] == '\0') {
			next = CONFIG_ZAPP_HAWKBIT_MIN_POLL_SEC;
			continue;
		}
		last = hawkbit_probe();
		probes++;
		if (last == HAWKBIT_UPDATE_INSTALLED) {
			printk("zapp: an update is in the second slot: rebooting into it\n");
			k_sleep(K_SECONDS(1));
			hawkbit_reboot();
		}
		/* the server says how often to ask; a server that did not answer is asked again soon */
		next = (last == HAWKBIT_NO_UPDATE)
			? MAX(hawkbit_get_poll_interval(), (uint32_t)CONFIG_ZAPP_HAWKBIT_MIN_POLL_SEC)
			: CONFIG_ZAPP_HAWKBIT_MIN_POLL_SEC;
	}
}

K_THREAD_DEFINE(zapp_hawkbit_thread, 8192, poll_thread, NULL, NULL, NULL, 12, 0, 3000);

static int cmd_status(const struct shell *sh, size_t argc, char **argv)
{
	struct mcuboot_img_header h;
	const char *addr = hawkbit_get_server_addr();
	const char *tok = hawkbit_get_ddi_security_token();
	bool known = boot_read_bank_header(PARTITION_ID(slot0_partition), &h, sizeof(h)) == 0 &&
		     h.mcuboot_version == 1;

	shell_fprintf(sh, SHELL_NORMAL, "hawkbit image %d.%d.%d %s server ",
		      known ? h.h.v1.sem_ver.major : 0, known ? h.h.v1.sem_ver.minor : 0,
		      known ? h.h.v1.sem_ver.revision : 0,
		      boot_is_img_confirmed() ? "confirmed" : "unconfirmed");
	if (addr && addr[0]) {
		shell_fprintf(sh, SHELL_NORMAL, "%s:%u", addr, hawkbit_get_server_port());
	} else {
		shell_fprintf(sh, SHELL_NORMAL, "none");
	}
	shell_print(sh, " id %s token %s net %s action %d probes %u last %s",
		    target_id[0] ? target_id : "none", (tok && tok[0]) ? "set" : "none",
		    net_up() ? "up" : "down", hawkbit_get_action_id(), probes, result(last));
	return 0;
}

static int cmd_probe(const struct shell *sh, size_t argc, char **argv)
{
	k_sem_give(&kick);
	shell_print(sh, "hawkbit probe requested");
	return 0;
}

SHELL_STATIC_SUBCMD_SET_CREATE(hawkbit_cmds,
	SHELL_CMD_ARG(status, NULL, "the image, the server, the last answer", cmd_status, 1, 0),
	SHELL_CMD_ARG(probe, NULL, "ask the server now", cmd_probe, 1, 0),
	SHELL_SUBCMD_SET_END);
SHELL_SUBCMD_ADD((zapp), hawkbit, &hawkbit_cmds, "updates from a hawkBit server", NULL, 1, 0);
```

## src/locate.c
```c
/*
 * `zapp locate on|off|blink [seconds]`: the board's LED, to find the board on a bench. A plain LED
 * (the devicetree's led0) or the first pixel of an addressable strip (led-strip: the WS2812 on a
 * KB2040 or a Pro Micro RP2040), whichever the board has. `blink` with no seconds, or 0, blinks
 * until `off`. Prints `locate <what>`.
 */
#include <stdlib.h>
#include <string.h>

#include <zephyr/device.h>
#include <zephyr/kernel.h>
#include <zephyr/shell/shell.h>

#if DT_NODE_EXISTS(DT_ALIAS(led_strip))
#include <zephyr/drivers/led_strip.h>

static const struct device *const strip = DEVICE_DT_GET(DT_ALIAS(led_strip));

static void light(bool on)
{
	struct led_rgb px = {.r = on ? 0x30 : 0, .g = on ? 0x30 : 0, .b = on ? 0x30 : 0};

	led_strip_update_rgb(strip, &px, 1);
}

static bool ready(void)
{
	return device_is_ready(strip);
}
#else
#include <zephyr/drivers/gpio.h>

static const struct gpio_dt_spec led = GPIO_DT_SPEC_GET(DT_ALIAS(led0), gpios);

static void light(bool on)
{
	gpio_pin_set_dt(&led, on);
}

static bool ready(void)
{
	return gpio_is_ready_dt(&led) && gpio_pin_configure_dt(&led, GPIO_OUTPUT_INACTIVE) == 0;
}
#endif

static bool lit;
static int64_t until;   /* uptime in ms when blinking stops; 0 blinks until off */
static void blink(struct k_work *work);
static K_WORK_DELAYABLE_DEFINE(blinker, blink);

static void blink(struct k_work *work)
{
	if (until && k_uptime_get() >= until) {
		lit = false;
		light(false);
		return;
	}
	lit = !lit;
	light(lit);
	k_work_reschedule(&blinker, K_MSEC(250));
}

static int cmd_locate(const struct shell *sh, size_t argc, char **argv)
{
	if (!ready()) {
		shell_error(sh, "locate: the LED is not ready");
		return -ENODEV;
	}
	k_work_cancel_delayable(&blinker);
	if (strcmp(argv[1], "on") == 0 || strcmp(argv[1], "off") == 0) {
		lit = strcmp(argv[1], "on") == 0;
		light(lit);
		shell_print(sh, "locate %s", argv[1]);
		return 0;
	}
	if (strcmp(argv[1], "blink") == 0) {
		long s = argc > 2 ? strtol(argv[2], NULL, 10) : 0;

		until = s > 0 ? k_uptime_get() + s * 1000 : 0;
		k_work_reschedule(&blinker, K_NO_WAIT);
		shell_print(sh, "locate blink %ld", s > 0 ? s : 0);
		return 0;
	}
	shell_error(sh, "locate: on, off or blink [seconds]");
	return -EINVAL;
}

SHELL_SUBCMD_ADD((zapp), locate, NULL, "on|off|blink [seconds]: the board's LED", cmd_locate, 2, 1);
```

## src/selftest.c
```c
/*
 * `zapp test <name>`: checks of the board's own hardware, one line each, for a layout's device
 * tests (`bench_tests`: a command and the line it expects):
 *
 *     test flash pass 64 bytes written, read back and deleted
 *     test temp fail no sensor
 *
 * flash    a setting written to the storage partition, read back, compared and deleted
 * entropy  two draws from the random source, not equal and not all zero
 * temp     the die temperature, between 0 and 90 C (on a chip with a sensor: the RP2040's)
 * wifi     the link up with an address (in a build with WiFi): when it is not, the network the
 *          settings name now is joined first (settings written since boot) and given 20 s
 * all      each of the above this build has; `zapp test list` names them
 */
#include <errno.h>
#include <string.h>

#include <zephyr/device.h>
#include <zephyr/drivers/sensor.h>
#include <zephyr/kernel.h>
#include <zephyr/random/random.h>
#include <zephyr/settings/settings.h>
#include <zephyr/shell/shell.h>

#include "zapp.h"

#define SCRATCH "test/scratch"
#define DIE_TEMP DT_ALIAS(die_temp0)
#define HAS_TEMP (DT_NODE_HAS_STATUS(DIE_TEMP, okay) && IS_ENABLED(CONFIG_SENSOR))

struct readback {
	uint8_t buf[64];
	ssize_t len;
};

static int read_cb(const char *key, size_t len, settings_read_cb rd, void *cb_arg, void *param)
{
	struct readback *r = param;

	if (settings_name_next(key, NULL) != 0) {
		return 0;
	}
	r->len = len > sizeof(r->buf) ? -EFBIG : rd(cb_arg, r->buf, len);
	return 0;
}

static bool t_flash(const struct shell *sh)
{
	uint8_t want[64];
	struct readback got = {.len = -ENOENT};

	sys_rand_get(want, sizeof(want));
	int rc = settings_save_one(SCRATCH, want, sizeof(want));

	if (!rc) {
		rc = settings_load_subtree_direct(SCRATCH, read_cb, &got);
	}
	settings_delete(SCRATCH);
	if (rc || got.len != sizeof(want) || memcmp(got.buf, want, sizeof(want))) {
		shell_print(sh, "test flash fail rc %d, read %d bytes", rc, (int)got.len);
		return false;
	}
	shell_print(sh, "test flash pass %d bytes written, read back and deleted", (int)sizeof(want));
	return true;
}

static bool t_entropy(const struct shell *sh)
{
	uint8_t a[32], b[32], zero[32] = {0};

	sys_rand_get(a, sizeof(a));
	sys_rand_get(b, sizeof(b));
	if (!memcmp(a, b, sizeof(a)) || !memcmp(a, zero, sizeof(a))) {
		shell_print(sh, "test entropy fail two draws equal or zero");
		return false;
	}
	shell_print(sh, "test entropy pass two 32-byte draws differ");
	return true;
}

static bool t_temp(const struct shell *sh)
{
#if HAS_TEMP
	const struct device *dev = DEVICE_DT_GET(DIE_TEMP);
	struct sensor_value v;

	if (!device_is_ready(dev) || sensor_sample_fetch(dev) ||
	    sensor_channel_get(dev, SENSOR_CHAN_DIE_TEMP, &v)) {
		shell_print(sh, "test temp fail the sensor did not answer");
		return false;
	}
	if (v.val1 < 0 || v.val1 > 90) {
		shell_print(sh, "test temp fail %d C", v.val1);
		return false;
	}
	shell_print(sh, "test temp pass %d C", v.val1);
	return true;
#else
	shell_print(sh, "test temp fail no sensor");
	return false;
#endif
}

static bool t_wifi(const struct shell *sh)
{
#ifdef CONFIG_ZAPP_WIFI
	char addr[16];

	if (!zapp_wifi_up(addr, sizeof(addr))) {
		settings_load_subtree("wifi");   /* settings written since boot */
		if (zapp_wifi_connect() == -ENOENT) {
			shell_print(sh, "test wifi fail no network in the settings (wifi/ssid)");
			return false;
		}
		for (int i = 0; i < 40 && !zapp_wifi_up(addr, sizeof(addr)); i++) {
			k_msleep(500);
		}
	}
	if (zapp_wifi_up(addr, sizeof(addr))) {
		shell_print(sh, "test wifi pass up at %s", addr);
		return true;
	}
	shell_print(sh, "test wifi fail not up within 20 s (zapp wifi status)");
	return false;
#else
	shell_print(sh, "test wifi fail no WiFi in this build");
	return false;
#endif
}

static const struct {
	const char *name;
	bool (*run)(const struct shell *sh);
	bool here;
} tests[] = {
	{"flash", t_flash, true},
	{"entropy", t_entropy, true},
	{"temp", t_temp, HAS_TEMP},
	{"wifi", t_wifi, IS_ENABLED(CONFIG_ZAPP_WIFI)},
};

static int cmd_test(const struct shell *sh, size_t argc, char **argv)
{
	bool all = strcmp(argv[1], "all") == 0, list = strcmp(argv[1], "list") == 0;
	int failed = 0, ran = 0;

	for (size_t i = 0; i < ARRAY_SIZE(tests); i++) {
		if (list) {
			if (tests[i].here) {
				shell_print(sh, "test %s", tests[i].name);
			}
		} else if ((all && tests[i].here) || strcmp(argv[1], tests[i].name) == 0) {
			ran++;
			failed += !tests[i].run(sh);
		}
	}
	if (list) {
		return 0;
	}
	if (!ran) {
		shell_print(sh, "test %s fail no such test (zapp test list)", argv[1]);
		return -EINVAL;
	}
	if (all) {
		shell_print(sh, "test all %s %d of %d", failed ? "fail" : "pass", ran - failed, ran);
	}
	return failed ? -EIO : 0;
}

SHELL_SUBCMD_ADD((zapp), test, NULL, "<name>|all|list: check the board's hardware", cmd_test, 2, 0);
```

## src/shell.c
```c
/*
 * The `zapp` command: each feature adds its subcommand from its own file (SHELL_SUBCMD_ADD), so
 * a build without a feature has no command for it.
 */
#include <zephyr/shell/shell.h>

SHELL_SUBCMD_SET_CREATE(zapp_cmds, (zapp));
SHELL_CMD_REGISTER(zapp, &zapp_cmds, "zapp's own commands", NULL);
```

## src/state.c
```c
/*
 * `zapp state`: rxrbench's state line (docs/PLUGINS.md "The state line"), one line a bench reads
 * with no code of its own:
 *
 *     ~S{"v":1,"family":"zephyr_settings","app":"zapp","fw":"3.0","target":"rpi_pico2/rp2350a/m33/w","id":"0123456789abcdef"}*1a2b
 *
 * The checksum is CRC-16/XMODEM of the JSON text as printed (crc16_itu_t with seed 0).
 */
#include <stdio.h>
#include <string.h>

#include <zephyr/drivers/hwinfo.h>
#include <zephyr/shell/shell.h>
#include <zephyr/sys/crc.h>

static int cmd_state(const struct shell *sh, size_t argc, char **argv)
{
	uint8_t raw[16];
	char id[2 * sizeof(raw) + 1] = "";
	char json[256];
	ssize_t n = hwinfo_get_device_id(raw, sizeof(raw));

	for (ssize_t i = 0; i < n; i++) {
		snprintf(&id[2 * i], 3, "%02x", raw[i]);
	}
	int len = snprintf(json, sizeof(json),
			   "{\"v\":1,\"family\":\"zephyr_settings\",\"app\":\"zapp\",\"fw\":\"%s\","
			   "\"target\":\"%s\",\"id\":\"%s\"}",
			   CONFIG_ZAPP_VERSION, CONFIG_BOARD_TARGET, id);

	if (len < 0 || len >= (int)sizeof(json)) {
		shell_error(sh, "state: too long");
		return -ENOMEM;
	}
	shell_print(sh, "~S%s*%04x", json, crc16_itu_t(0, (const uint8_t *)json, len));
	return 0;
}

SHELL_SUBCMD_ADD((zapp), state, NULL, "rxrbench's state line", cmd_state, 1, 0);
```

## src/wifi.c
```c
/*
 * WiFi from settings. wifi/ssid names the network and wifi/psk its key (a secret the layout
 * declares; no key means an open network). At boot, after the settings load, and on
 * `zapp wifi connect`, zapp joins it and takes an address by DHCP.
 *
 * A network that goes away is joined again without anyone asking: a thread looks every
 * WATCH_S seconds, and a link that has had no address for REJOIN_S (a join that never ended,
 * an access point that left without a word, a lease that ran out) is left and joined anew.
 * A board that takes its updates over this link gets none while it is down, so nothing here
 * waits for a person. `zapp wifi drop` leaves the network, to show that.
 *
 *     zapp wifi status   ->  wifi up <ssid> <address> | wifi joining <ssid> | wifi down <ssid> <why> | wifi none
 */
#include <errno.h>
#include <string.h>

#include <zephyr/kernel.h>
#include <zephyr/net/net_if.h>
#include <zephyr/net/dhcpv4.h>
#include <zephyr/net/net_mgmt.h>
#include <zephyr/net/wifi_mgmt.h>
#include <zephyr/settings/settings.h>
#include <zephyr/shell/shell.h>

#include "zapp.h"

static char ssid[33];
static char psk[65];
static enum { NONE, JOINING, JOINED, DOWN } link;
static int last_error;
static int64_t no_address_since;   /* uptime in ms when the link was first seen without one, or 0 */
static uint32_t rejoins;

#define WATCH_S  10
#define REJOIN_S 45   /* a join and a DHCP lease take a few seconds; this is neither */
static struct net_mgmt_event_callback wifi_cb, ip_cb;

static int wifi_set(const char *name, size_t len, settings_read_cb read_cb, void *cb_arg)
{
	const char *next;
	char *dst = NULL;
	size_t cap = 0;

	if (settings_name_steq(name, "ssid", &next) && !next) {
		dst = ssid, cap = sizeof(ssid);
	} else if (settings_name_steq(name, "psk", &next) && !next) {
		dst = psk, cap = sizeof(psk);
	} else {
		return 0;
	}
	if (len >= cap) {
		return -EINVAL;
	}
	ssize_t n = read_cb(cb_arg, dst, len);

	if (n < 0) {
		return (int)n;
	}
	dst[n] = '\0';
	return 0;
}

SETTINGS_STATIC_HANDLER_DEFINE(zapp_wifi, "wifi", NULL, wifi_set, NULL, NULL);

static void on_wifi(struct net_mgmt_event_callback *cb, uint64_t event, struct net_if *iface)
{
	const struct wifi_status *st = (const struct wifi_status *)cb->info;

	if (event == NET_EVENT_WIFI_CONNECT_RESULT) {
		if (st && st->status) {
			link = DOWN;
			last_error = st->status;
			return;
		}
		link = JOINING;   /* joined; up once DHCP gives an address */
		net_dhcpv4_start(iface);
	} else if (event == NET_EVENT_WIFI_DISCONNECT_RESULT) {
		link = DOWN;
		last_error = st ? st->status : 0;
	}
}

static void on_ip(struct net_mgmt_event_callback *cb, uint64_t event, struct net_if *iface)
{
	if (event == NET_EVENT_IPV4_ADDR_ADD) {
		link = JOINED;
	}
}

int zapp_wifi_connect(void)
{
	struct net_if *iface = net_if_get_wifi_sta();
	struct wifi_connect_req_params p = {0};

	if (!ssid[0]) {
		link = NONE;
		return -ENOENT;
	}
	if (!iface) {
		link = DOWN;
		last_error = -ENODEV;
		return -ENODEV;
	}
	p.ssid = (const uint8_t *)ssid;
	p.ssid_length = strlen(ssid);
	p.psk = (const uint8_t *)psk;
	p.psk_length = strlen(psk);
	p.security = psk[0] ? WIFI_SECURITY_TYPE_PSK : WIFI_SECURITY_TYPE_NONE;
	p.channel = WIFI_CHANNEL_ANY;
	p.band = WIFI_FREQ_BAND_2_4_GHZ;
	p.mfp = WIFI_MFP_OPTIONAL;
	p.timeout = SYS_FOREVER_MS;
	link = JOINING;
	int rc = net_mgmt(NET_REQUEST_WIFI_CONNECT, iface, &p, sizeof(p));

	if (rc == -EALREADY) {
		/* the driver still holds a join that leads nowhere: end it and ask again */
		(void)net_mgmt(NET_REQUEST_WIFI_DISCONNECT, iface, NULL, 0);
		k_sleep(K_SECONDS(1));
		link = JOINING;
		rc = net_mgmt(NET_REQUEST_WIFI_CONNECT, iface, &p, sizeof(p));
	}
	if (rc) {
		link = DOWN;
		last_error = rc;
	}
	return rc;
}

/* The link looked at every WATCH_S: one with no address for REJOIN_S is left and joined anew. */
static void watch(void *a, void *b, void *c)
{
	for (;;) {
		struct net_if *iface = net_if_get_wifi_sta();

		k_sleep(K_SECONDS(WATCH_S));
		if (!ssid[0] || !iface) {
			continue;
		}
		if (net_if_ipv4_get_global_addr(iface, NET_ADDR_PREFERRED) != NULL) {
			no_address_since = 0;
			link = JOINED;
			continue;
		}
		if (no_address_since == 0) {
			no_address_since = k_uptime_get();
			continue;
		}
		if (k_uptime_get() - no_address_since < REJOIN_S * MSEC_PER_SEC) {
			continue;
		}
		no_address_since = k_uptime_get();
		rejoins++;
		printk("zapp: wifi: no address for %d s: joining %s again (%u)\n", REJOIN_S, ssid, rejoins);
		(void)net_mgmt(NET_REQUEST_WIFI_DISCONNECT, iface, NULL, 0);
		k_sleep(K_SECONDS(1));
		(void)zapp_wifi_connect();
	}
}

K_THREAD_DEFINE(zapp_wifi_watch, 4096, watch, NULL, NULL, NULL, 13, 0, 5000);

bool zapp_wifi_up(char *addr, size_t len)
{
	struct net_if *iface = net_if_get_wifi_sta();
	struct net_in_addr *a = iface ? net_if_ipv4_get_global_addr(iface, NET_ADDR_PREFERRED) : NULL;

	if (link != JOINED || !a) {
		return false;
	}
	net_addr_ntop(NET_AF_INET, a, addr, len);
	return true;
}

void zapp_wifi_start(void)
{
	net_mgmt_init_event_callback(&wifi_cb, on_wifi,
				     NET_EVENT_WIFI_CONNECT_RESULT | NET_EVENT_WIFI_DISCONNECT_RESULT);
	net_mgmt_add_event_callback(&wifi_cb);
	net_mgmt_init_event_callback(&ip_cb, on_ip, NET_EVENT_IPV4_ADDR_ADD);
	net_mgmt_add_event_callback(&ip_cb);
	(void)zapp_wifi_connect();
}

static int cmd_status(const struct shell *sh, size_t argc, char **argv)
{
	char addr[NET_IPV4_ADDR_LEN];

	if (zapp_wifi_up(addr, sizeof(addr))) {
		shell_print(sh, "wifi up %s %s", ssid, addr);
	} else if (link == NONE || !ssid[0]) {
		shell_print(sh, "wifi none");
	} else if (link == JOINING || link == JOINED) {
		shell_print(sh, "wifi joining %s", ssid);
	} else {
		shell_print(sh, "wifi down %s %d", ssid, last_error);
	}
	return 0;
}

static int cmd_drop(const struct shell *sh, size_t argc, char **argv)
{
	struct net_if *iface = net_if_get_wifi_sta();
	int rc = iface ? net_mgmt(NET_REQUEST_WIFI_DISCONNECT, iface, NULL, 0) : -ENODEV;

	shell_print(sh, "wifi dropped %d", rc);
	return 0;
}

static int cmd_connect(const struct shell *sh, size_t argc, char **argv)
{
	settings_load_subtree("wifi");   /* settings written since boot */
	int rc = zapp_wifi_connect();

	if (rc == -ENOENT) {
		shell_print(sh, "wifi none");
		return 0;
	}
	shell_print(sh, rc ? "wifi down %s %d" : "wifi joining %s", ssid, rc);
	return rc;
}

SHELL_STATIC_SUBCMD_SET_CREATE(wifi_cmds,
	SHELL_CMD(status, NULL, "where the link is", cmd_status),
	SHELL_CMD(connect, NULL, "join the network the settings name", cmd_connect),
	SHELL_CMD(drop, NULL, "leave the network (it is joined again within a minute)", cmd_drop),
	SHELL_SUBCMD_SET_END);
SHELL_SUBCMD_ADD((zapp), wifi, &wifi_cmds, "WiFi from the settings wifi/ssid, wifi/psk", NULL, 1, 0);
```

## src/zapp.h
```c
/* What zapp's feature files offer one another. */
#ifndef ZAPP_H
#define ZAPP_H

#include <stdbool.h>
#include <stddef.h>

/* wifi.c: join the network the settings name (-ENOENT without one); whether it is up, and its address */
int zapp_wifi_connect(void);
bool zapp_wifi_up(char *addr, size_t len);
void zapp_wifi_start(void);

#endif
```
