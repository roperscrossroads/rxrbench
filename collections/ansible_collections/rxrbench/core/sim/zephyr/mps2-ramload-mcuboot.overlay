/* MCUboot's side of mps2-ramload.overlay (on the bootloader image only): its own RAM is
 * the 64 KB between the application's RAM and the simulated flash, and the application's
 * RAM, where RAM load copies the chosen image and runs it, is named for it. Without this
 * both images own the RAM from 0x20000000: MCUboot copies the image over its own data and
 * stack before validating it, and locks the CPU up in the fault handler. */
/delete-node/ &sram0;

/ {
	chosen {
		zephyr,sram = &sram0;
		mcuboot,image-ram = &image_ram;
	};

	sram0: memory@202e0000 {
		compatible = "mmio-sram";
		reg = <0x202E0000 DT_SIZE_K(63)>;	/* the last 1 KB is the retained region */
	};

	image_ram: memory@20000000 {
		compatible = "mmio-sram";
		reg = <0x20000000 0x002E0000>;
	};
};
